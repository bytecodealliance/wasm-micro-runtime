## wamr-sdk/Kconfig
```kconfig
mainmenu "WebAssembly Micro Runtime Configuration"

config WAMR_SDK_PROFILE
    string "wamr sdk profile name"
    default "default"
    help
        create a new SDK by giving a name or overwrite
        the "default" profile

choice
    prompt "select a build target"

    config TARGET_X86_64
        bool "X86_64"

    config TARGET_X86_32
        bool "X86_32"

endchoice

choice
    prompt "select a target platform"

    config PLATFORM_LINUX
        bool "Linux"

endchoice

menu "select execution mode"
    comment "At least one execution mode must be selected"
    config EXEC_AOT
        bool "AOT"
        depends on PLATFORM_LINUX

    config EXEC_JIT
        bool "JIT"
        depends on PLATFORM_LINUX
        select BUILD_LLVM

    config BUILD_LLVM
        bool "build llvm (this may take a long time)"
        depends on EXEC_JIT
        help
            llvm library is required by JIT mode.

    config EXEC_INTERP
        bool "INTERPRETER"
        default y
endmenu

choice
    prompt "libc support"

    config LIBC_BUILTIN
        bool "builtin libc"
        help
            use builtin libc, this is a minimal subset of libc.

    config LIBC_WASI
        bool "WebAssembly System Interface [WASI]"
        depends on PLATFORM_LINUX
        help
            enable WebAssembly System Interface

endchoice

config APP_FRAMEWORK_ENABLE
    bool "enable app framework"
    help
        enable wamr app framework

menu "app modules"
    depends on APP_FRAMEWORK_ENABLE

    config APP_BUILD_ALL
        bool "enable all modules"

    source ".wamr_modules"

endmenu

config EXTRA_INCLUDE_ENABLE
    bool "enable extra include dir"

config EXTRA_INCLUDE_PATH
    string "external include path"
    depends on EXTRA_INCLUDE_ENABLE
    help
        Pass external include path to be added in the SDK
        This is useful when your app modules need some external
        header files, such as the wgl modules which need some config
        file when building the runtime library
```
